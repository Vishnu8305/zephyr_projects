## build/Kconfig/boards/Kconfig.defconfig
```kconfig
# Load Zephyr board defconfig descriptions.
osource "/home/vishnu/zephyrproject/zephyr/boards/st/nucleo_l476rg/Kconfig.defconfig"
```

## build/Kconfig/boards/Kconfig.nucleo_l476rg
```kconfig
# Load board Kconfig descriptions.
osource "/home/vishnu/zephyrproject/zephyr/boards/st/nucleo_l476rg/Kconfig.nucleo_l476rg"
```

## build/Kconfig/boards/Kconfig.sysbuild
```kconfig
# Load Sysbuild board Kconfig descriptions.
osource "/home/vishnu/zephyrproject/zephyr/boards/st/nucleo_l476rg/Kconfig.sysbuild"
```
